## components/esp_now_source/Kconfig
```kconfig
menu "ACRouter ESP-NOW Source (v2.0 wireless)"

config ACROUTER_ESPNOW_SOURCE
    bool "Enable ESP-NOW wireless measurement source"
    # ESP-NOW is an ESP32-tier feature only: default ON for the ESP32 full build,
    # OFF for every other target (ESP32-C2 uses wired DimmerLink-I2C, not ESP-NOW).
    # Encoding the policy here (not just in a defaults layer) makes it robust to a
    # stale generated sdkconfig flipping it on for the C2 (operator decision 2026-07-17).
    default y if IDF_TARGET_ESP32
    default n
    help
        Receive rbAmp measurements from wireless nodes over ESP-NOW (rbgrid wire
        protocol) and feed them into the Sensor Hub as ACROUTER_SOURCE_ESPNOW
        events (priority 0), the same merge path the internal ADC and rbAmp I2C
        sources use.

        Minimal scope: RX rbAmp REALTIME only, open (unencrypted) bring-up. No
        master/PTP time-sync, no period/billing. Dimmer control TX to nodes is a
        later addition. Safe to enable with no node present.

if ACROUTER_ESPNOW_SOURCE

config ACROUTER_ESPNOW_CHANNEL
    int "Force WiFi/ESP-NOW channel (0 = keep current)"
    default 0
    range 0 13
    help
        ESP-NOW peers must share one WiFi channel. 0 = use ACRouter's current
        WiFi channel (AP channel, or the router's channel in STA mode) and have
        the node match it. Set >0 only if you need to pin a specific channel
        (may disrupt an STA uplink).

endif

endmenu
```

## components/rbamp_source/Kconfig
```kconfig
menu "ACRouter rbAmp Source (v2.0 sensing)"

config ACROUTER_RBAMP_SOURCE
    bool "Enable rbAmp I2C sensor source"
    default n
    help
        Poll rbAmp sensor modules over the shared I2C bus and feed their
        measurements into the Sensor Hub as an ACROUTER_SOURCE_I2C source
        (priority 0, preferred over the internal ADC).

        This is the v2.0 sensing-offload path: rbAmp modules do the
        current/voltage/power DSP on-device (5 Hz commit), so the ESP32 no
        longer needs local ADC sampling. Additive — runs alongside the
        internal ADC source until ADC is removed in a later phase.

        Safe to enable with no modules present: discovery finds nothing and
        the poll task posts nothing. Requires rbAmp hardware to produce data.

if ACROUTER_RBAMP_SOURCE

config ACROUTER_RBAMP_POLL_MS
    int "rbAmp poll interval (ms)"
    default 200
    range 100 5000
    help
        Fleet poll cadence. rbAmp commits RMS metrics every 200 ms (5 Hz,
        hard floor); polling faster than 200 ms yields no fresher data.

comment "Module role mapping (0x00 = unset). Assigns a discovered module's primary channel to a Sensor Hub slot."

config ACROUTER_RBAMP_GRID_ADDR
    hex "Grid rbAmp module I2C address"
    default 0x00
    help
        7-bit address of the rbAmp module measuring the GRID feed. 0 = none.

config ACROUTER_RBAMP_SOLAR_ADDR
    hex "Solar rbAmp module I2C address"
    default 0x00
    help
        7-bit address of the rbAmp module measuring the SOLAR feed. 0 = none.

config ACROUTER_RBAMP_LOAD_ADDR
    hex "Load rbAmp module I2C address"
    default 0x00
    help
        7-bit address of the rbAmp module measuring the LOAD feed. 0 = none.

config ACROUTER_RBAMP_VOLTAGE_ADDR
    hex "Dedicated voltage rbAmp module I2C address"
    default 0x00
    help
        7-bit address of a voltage-only rbAmp module. 0 = none (grid module's
        voltage is used when it has voltage hardware).

config ACROUTER_RBAMP_AUTOSCAN
    bool "Auto-discover rbAmp modules at init"
    default y
    help
        Scan the bus for rbAmp modules (by PRODUCT_ID) at init and add them
        to the fleet. Discovered modules are polled and logged (diagnostic);
        assign a Sensor Hub role per module via rbamp_source_configure() to
        feed the routing control loop.

config ACROUTER_RBAMP_TASK_WDT
    bool "Subscribe poll task to Task Watchdog"
    default y
    help
        A wedged I2C bus can block the IDF i2c_master driver indefinitely
        (the library cannot interrupt a blocking same-task call). Subscribing
        the poll task to the Task WDT auto-reboots cleanly out of a wedge.
        Recommended for production (rbAmp fleet guidance).

endif

endmenu
```

## main/Kconfig.projbuild
```kconfig
menu "ACRouter interfaces (C2/ESP32 tiering)"

# See docs/18_C2_ESP32_TIERING_PLAN.md. These gate the two remote interfaces at
# compile time so a build links only what it runs. Both default to y here (preserves
# the current behavior); the C2 profiles flip them — C2-HTTP: MQTT off, C2-MQTT: HTTP
# off (C2 runs EXACTLY ONE interface). ESP32 keeps both.

config ACROUTER_HTTP_SERVER
    bool "Enable on-device HTTP server + REST/WS API"
    default y
    help
        The device's HTTP/REST + WebSocket API that the external web app talks to.
        Disable for a headless MQTT-only build (e.g. the C2-MQTT profile), which is
        provisioned over MQTT instead of a local web UI.

config ACROUTER_MQTT_CLIENT
    bool "Enable MQTT client (telemetry + Home Assistant)"
    default n if IDF_TARGET_ESP32C2
    default y
    help
        The MQTT client: telemetry publish, Home Assistant auto-discovery, and inbound
        command intake.

        WARNING: heavy on the RAM-limited ESP32-C2 — esp-mqtt pulls in the TLS
        transport (mbedTLS), a large heap/flash consumer. On the C2 run EITHER HTTP or
        MQTT, never both. On ESP32 both run concurrently (ample RAM + a second core).

        DEFAULT OFF on the ESP32-C2 (the C2-HTTP profile): empirically, both interfaces
        + the isolated control task overflow the C2 heap and starve WiFi. Enable it only
        for a C2-MQTT (HTTP-off) build, and disable ACROUTER_HTTP_SERVER there.

config ACROUTER_OTA
    bool "Enable OTA firmware update (local upload + GitHub check)"
    default n if IDF_TARGET_ESP32C2
    default y
    help
        On-device firmware update: local HTTP upload + the GitHub update check.

        DEFAULT OFF on the ESP32-C2 (docs/18 §4): the C2 updates via manual UART flash,
        which also lets the partition table drop the ota_0/ota_1/otadata slots and give
        the app ~2x the space. Reported as features.ota in /api/info so the web client
        hides the OTA page when this build has no OTA.

config ACROUTER_MQTT_BOOTSTRAP
    bool "MQTT bootstrap: seed broker + enable when NVS is unconfigured"
    depends on ACROUTER_MQTT_CLIENT
    default n
    help
        For the headless C2-MQTT profile: if NVS has no broker (fresh device, or a
        board provisioned under a non-MQTT profile), seed ACROUTER_MQTT_BOOTSTRAP_BROKER
        and enable MQTT so the device reaches the broker on first boot — there is no
        HTTP UI to configure it. NVS always wins when it carries a broker (e.g. a later
        config/set over MQTT persists and overrides). If both NVS and the bootstrap
        broker are empty, MQTT stays disabled (safe-idle). docs/18 §5.

config ACROUTER_MQTT_BOOTSTRAP_BROKER
    string "Bootstrap broker URL (mqtt://host:port)"
    depends on ACROUTER_MQTT_BOOTSTRAP
    default ""
    help
        Set this in the gitignored sdkconfig.c2mqtt so no LAN broker address is
        committed to the repo. Empty -> bootstrap is a no-op (safe-idle).

config ACROUTER_I2C_AUTODISCOVERY
    bool "Enable on-demand I2C bus rescan (hot-add modules at runtime)"
    default n if IDF_TARGET_ESP32C2
    default y
    help
        On-demand rescan of the I2C bus for newly-attached rbAmp/DimmerLink modules,
        triggered from the web UI or the serial console. The rescan pauses the ~5 Hz poll
        and re-probes the bus.

        DEFAULT OFF on the ESP32-C2 (docs/18): the pause+reprobe contends with the control
        loop and the single-core web/MQTT stack — empirically it stalls the C2 web server.
        The fleet is still established once at boot from the modules present on the bus
        (that boot scan is retained); only the runtime rescan is disabled. When off,
        rbamp_source_rescan() returns ESP_ERR_NOT_SUPPORTED and the /api rescan endpoint
        reports {success:false}. On ESP32 (dual-core, ample RAM) it stays on.

endmenu
```

## sdkconfig.defaults
```kconfig
# ESP32 AC Power Router Controller - Default SDK Configuration

# FreeRTOS Configuration
# Arduino requires 1000 Hz tick rate
CONFIG_FREERTOS_HZ=1000

# Flash Configuration
CONFIG_ESPTOOLPY_FLASHSIZE_4MB=y
CONFIG_ESPTOOLPY_FLASHSIZE="4MB"

# Partition Table
CONFIG_PARTITION_TABLE_CUSTOM=y
CONFIG_PARTITION_TABLE_CUSTOM_FILENAME="partitions.csv"

# Component Config
# Arduino-specific settings
CONFIG_ARDUINO_LOOP_STACK_SIZE=8192
CONFIG_ARDUINO_RUNNING_CORE=1
CONFIG_ARDUINO_EVENT_RUNNING_CORE=1

# --- ESP32 dual-core tiering (docs/18 §11) ---
# Comms plane on core 0, control plane on core 1. Pin the network stacks to core 0
# so the core-1 control task is never preempted by the TCP/IP or MQTT client task.
# Single-core C2 has only core 0 — these are no-ops there (esp32c2 defaults already
# override the multi-core Arduino assumptions above). Previously these lived only in
# the gitignored sdkconfig; tracked here so a fresh checkout keeps the isolation.
CONFIG_LWIP_TCPIP_TASK_AFFINITY_CPU0=y
CONFIG_MQTT_TASK_CORE_SELECTION_ENABLED=y
CONFIG_MQTT_USE_CORE_0=y

CONFIG_DIAG_USE_EXTERNAL_LOG_WRAP=y

# Disable I2C Slave (compatibility issue with ESP-IDF 5.4.1)
CONFIG_ARDUINO_I2C_SLAVE=n

# ESP32-specific
CONFIG_ESP_DEFAULT_CPU_FREQ_MHZ_240=y
CONFIG_ESP_DEFAULT_CPU_FREQ_MHZ=240

# WiFi
CONFIG_ESP_WIFI_STATIC_RX_BUFFER_NUM=10
CONFIG_ESP_WIFI_DYNAMIC_RX_BUFFER_NUM=32
CONFIG_ESP_WIFI_DYNAMIC_TX_BUFFER_NUM=32

# ADC
CONFIG_ADC_CAL_EFUSE_TP_ENABLE=y
CONFIG_ADC_CAL_EFUSE_VREF_ENABLE=y
CONFIG_ADC_CAL_LUT_ENABLE=y

# Compiler options
CONFIG_COMPILER_OPTIMIZATION_SIZE=y
CONFIG_COMPILER_STACK_CHECK_MODE_NORM=y

# Log output
CONFIG_LOG_DEFAULT_LEVEL_INFO=y
CONFIG_LOG_MAXIMUM_LEVEL_VERBOSE=y

# Main task stack size
CONFIG_ESP_MAIN_TASK_STACK_SIZE=8192

# System
CONFIG_ESP_SYSTEM_EVENT_TASK_STACK_SIZE=4096

# ESP Timer - critical for dimmer timing
# Enable ISR dispatch method for minimal latency
CONFIG_ESP_TIMER_SUPPORTS_ISR_DISPATCH_METHOD=y
# Run esp_timer ISR on CPU1 (APP_CPU) to avoid WiFi conflicts on CPU0
CONFIG_ESP_TIMER_ISR_AFFINITY_CPU1=y
# Higher interrupt level for timing-critical operations
CONFIG_ESP_TIMER_INTERRUPT_LEVEL=3

# v2.0 sensing path: rbAmp I2C source on by default (was Kconfig default-n, left off for ESP32 -> grid never polled).
CONFIG_ACROUTER_RBAMP_SOURCE=y
```

## sdkconfig.defaults.c2mqtt
```kconfig
# C2-MQTT profile (docs/18 §4) — headless MQTT-only build for the ESP32-C2.
# Passed via SDKCONFIG_DEFAULTS in build_c2mqtt.bat AFTER sdkconfig.defaults +
# sdkconfig.defaults.esp32c2, so it survives `idf.py set-target` (which regenerates
# sdkconfig from the defaults layer — a plain override in sdkconfig.c2mqtt would be
# wiped). HTTP off, MQTT on, OTA off, autodiscovery off, MQTT bootstrap on.
# The bootstrap broker URL lives in the gitignored sdkconfig.defaults.c2mqtt.local
# (kept out of the repo).

# CONFIG_ACROUTER_HTTP_SERVER is not set
CONFIG_ACROUTER_MQTT_CLIENT=y
# CONFIG_ACROUTER_OTA is not set
# CONFIG_ACROUTER_I2C_AUTODISCOVERY is not set
CONFIG_ACROUTER_MQTT_BOOTSTRAP=y
# ESP-NOW is ESP32-tier; the C2 uses wired DimmerLink-I2C (tiering). Force it off so a
# stale generated sdkconfig can't leave it on (which surfaced a phantom ESP-NOW dimmer).
# CONFIG_ACROUTER_ESPNOW_SOURCE is not set
```

## sdkconfig.defaults.esp32c2
```kconfig
# ESP32-C2 (ESP8684) overrides — single-core RISC-V, applied on top of
# sdkconfig.defaults for `idf.py set-target esp32c2`. The shared defaults carry
# ESP32 dual-core assumptions that are invalid here; override them.

# Single core: Arduino task + event loop must run on core 0 (no APP_CPU).
CONFIG_ARDUINO_RUNNING_CORE=0
CONFIG_ARDUINO_EVENT_RUNNING_CORE=0

# CPU: C2 tops out at 120 MHz (not 240).
# CONFIG_ESP_DEFAULT_CPU_FREQ_MHZ_240 is not set
CONFIG_ESP_DEFAULT_CPU_FREQ_MHZ_120=y
CONFIG_ESP_DEFAULT_CPU_FREQ_MHZ=120

# Crystal: this board (ESP8684H / WROOM-02C) uses a 26 MHz crystal. IDF 5.5
# esp32c2 has no autodetect choice, so pin it — otherwise the default 40 MHz
# skews every clock and the UART console prints garbage (115200*26/40=74880).
CONFIG_XTAL_FREQ_26=y

# esp_timer: no APP_CPU on unicore — the CPU1 ISR affinity from the shared
# defaults is invalid here; pin the ISR to CPU0.
# CONFIG_ESP_TIMER_ISR_AFFINITY_CPU1 is not set
CONFIG_ESP_TIMER_ISR_AFFINITY_CPU0=y

# Flash size is inherited (4MB) from sdkconfig.defaults; this board reports 4MB.

# rbAmp source (bench bring-up): poll the fleet + seed 0x50 as GRID (UI1 module)
CONFIG_ACROUTER_RBAMP_SOURCE=y
CONFIG_ACROUTER_RBAMP_GRID_ADDR=0x51

# ESP-NOW is ESP32-tier ONLY (operator decision 2026-07-17): the C2 uses wired
# DimmerLink-I2C, not ESP-NOW. Kept off for every C2 profile — the Kconfig
# `default y if IDF_TARGET_ESP32 / default n` also enforces this so a stale
# generated sdkconfig cannot flip it back on. (Supersedes the earlier C2-as-hub design.)
# CONFIG_ACROUTER_ESPNOW_SOURCE is not set
```
